## components/bk_genie_core/Kconfig
```kconfig
menu "Beken Genie Configuration"
	config BEKEN_GENIE_CORE
        bool "Enable Beken Genie Core"
        default n

    config LDO3V3_ENABLE
        bool "Enable LDO_3V3"
        default n

    config LDO3V3_CTRL_GPIO
        depends on LDO3V3_ENABLE
        int "Set LDO_3V3 Control Gpio"
        range 0 100
        default 52

	config NETWORK_AUTO_RECONNECT
		bool "Enable auto reconnect Network"
		default y

	choice G722_CODEC_RUN_CPU
		prompt "Select G722 Codec run cpu"
		default G722_CODEC_RUN_ON_CPU1

		config G722_CODEC_RUN_ON_CPU1
		bool "Select g722 codec run on cpu1"
		help
			Use g722 codec in avdk sdk

		config G722_CODEC_RUN_ON_CPU0
		bool "Select g722 codec run on cpu0"
		help
			Use g722 codec in rtc SDK
	endchoice

endmenu
```

## components/bk_unisound_asr/Kconfig
```kconfig
menu "Beken Unisound ASR"

	config BEKEN_UNISOUND_ASR
		depends on UNISOUND
		bool "Enable bk_unisound_asr component"
		default n

	config BEKEN_UNISOUND_ASR_TEST
		depends on BEKEN_UNISOUND_ASR && AUDIO_RECORD
		bool "Enable bk_unisound_asr component test case"
		default n

	choice BEKEN_UNISOUND_ASR_USE_MEMORY
		depends on BEKEN_UNISOUND_ASR
		prompt "Select beken unisound asr use memory"
		default BEKEN_UNISOUND_ASR_USE_SRAM

		config BEKEN_UNISOUND_ASR_USE_SRAM
		bool "Enable beken unisound asr use sram"

		config BEKEN_UNISOUND_ASR_USE_PSRAM
		bool "Enable beken unisound asr use psram"
	endchoice

endmenu
```

## components/bk_wanson_foreign_asr/Kconfig
```kconfig
menu "Bk_thirdparty::Wanson_Foreign"

	config WANSON_FOREIGN_ASR
		bool "Enable Wanson_Foreign ASR"
		default n
		help
			Enable Wanson_Foreign Automatic Speech Recognition

	choice BEKEN_WANSON_ASR_USE_MEMORY
		depends on WANSON_FOREIGN_ASR
		prompt "Select beken wanson asr use memory"
		default BEKEN_WANSON_ASR_USE_PSRAM

		config BEKEN_WANSON_ASR_USE_SRAM
		bool "Enable beken wanson asr use sram"

		config BEKEN_WANSON_ASR_USE_PSRAM
		bool "Enable beken wanson asr use psram"
	endchoice
endmenu
```

## projects/common_components/asr/Kconfig
```kconfig
menu "asr"

	choice ASR_ENGINE_SELECT
		prompt "Select ASR Engine"
		default ASR_ENGINE_WANSON

		config ASR_ENGINE_WANSON
			depends on WANSON_ASR
			bool "Use Wanson ASR Engine"
			help
			Select Wanson ASR as the speech recognition engine

		config ASR_ENGINE_WANSON_FOREIGN
			depends on WANSON_FOREIGN_ASR
			bool "Use Wanson ASR foreign Engine"
			help
			Select Wanson ASR foreign as the speech recognition engine

		config ASR_ENGINE_UNISOUND
			depends on BEKEN_UNISOUND_ASR
			bool "Use Unisound ASR Engine"
			help
			Select Unisound ASR as the speech recognition engine
	endchoice

endmenu
```
