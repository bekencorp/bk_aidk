## components/bk_avi_play/Kconfig
```kconfig
menu "BK_avi_play"
    config AVI_PLAY
        bool "Enable AVI Play"
        default n
endmenu
```

## components/bk_tflite_micro/Kconfig
```kconfig
menu "TFLite Micro"
	config TFLITE_MICRO
		bool "Enable TFLite Micro"
		default n
endmenu
```

## components/bk_wanson_asr/Kconfig
```kconfig
menu "Beken Wanson ASR"

	config BEKEN_WANSON_ASR
		depends on WANSON_ASR
		bool "Enable bk_wanson_asr component"
		default n

	config BEKEN_WANSON_ASR_TEST
		depends on BEKEN_WANSON_ASR && AUDIO_RECORD
		bool "Enable bk_wanson_asr component test case"
		default n

	choice BEKEN_WANSON_ASR_USE_MEMORY
		depends on BEKEN_WANSON_ASR
		prompt "Select beken wanson asr use memory"
		default BEKEN_WANSON_ASR_USE_PSRAM

		config BEKEN_WANSON_ASR_USE_SRAM
		bool "Enable beken wanson asr use sram"

		config BEKEN_WANSON_ASR_USE_PSRAM
		bool "Enable beken wanson asr use psram"
	endchoice

endmenu
```

## projects/ai_dashboard/main/Kconfig.projbuild
```kconfig
menu "Beken_Genie Project Configuration"
    config LDO3V3_ENABLE
        bool "Enabel LDO_3V3"
        default n

    config LDO3V3_CTRL_GPIO
        depends on LDO3V3_ENABLE
        int "Set LDO_3V3 Control Gpio"
        range 0 100
        default 52

    config LCD_BACKLIGHT_GPIO
        int "Set LCD Backlight Control Gpio"
        range 0 100
        default 25

    config LCD_QSPI_RESET_PIN
        int "Set LCD QSPI Reset Gpio"
        range 0 100
        default 45

    config LCD_QSPI_ID
        int "Set LCD QSPI ID"
        default 0
        help
            0 - QSPI_ID_0
            1 - QSPI_ID_1

    choice G722_CODEC_RUN_CPU
        prompt "Select G722 Codec run cpu"
        default G722_CODEC_RUN_ON_CPU1

        config G722_CODEC_RUN_ON_CPU1
        bool "Select g722 codec run on cpu1"
        help
            Use g722 codec in avdk sdk

        config G722_CODEC_RUN_ON_CPU0
        bool "Select g722 codec run on cpu0"
        help
            Use g722 codec in agora_iot_sdk
    endchoice
endmenu
```

## projects/beken_genie/main/Kconfig.projbuild
```kconfig
menu "Beken_Genie Project Configuration"
    config LDO3V3_ENABLE
        bool "Enabel LDO_3V3"
        default n

    config LDO3V3_CTRL_GPIO
        depends on LDO3V3_ENABLE
        int "Set LDO_3V3 Control Gpio"
        range 0 100
        default 52

	config NETWORK_AUTO_RECONNECT
		bool "Enable auto reconnect Network"
		default y

	config BK_AGORA_DEV_STARTUP_AGENT
                bool "Enable start agent on device"
                default n

	choice G722_CODEC_RUN_CPU
		prompt "Select G722 Codec run cpu"
		default G722_CODEC_RUN_ON_CPU1

		config G722_CODEC_RUN_ON_CPU1
		bool "Select g722 codec run on cpu1"
		help
			Use g722 codec in avdk sdk

		config G722_CODEC_RUN_ON_CPU0
		bool "Select g722 codec run on cpu0"
		help
			Use g722 codec in agora_iot_sdk
	endchoice

endmenu
```

## projects/beken_genie_ab/main/Kconfig.projbuild
```kconfig
menu "Beken_Genie Project Configuration"
    config LDO3V3_ENABLE
        bool "Enabel LDO_3V3"
        default n

    config LDO3V3_CTRL_GPIO
        depends on LDO3V3_ENABLE
        int "Set LDO_3V3 Control Gpio"
        range 0 100
        default 52

    config HARDWARE_SPEAKER_VER
        int "select HARDWARE_SPEAKER_VER"
        range 0 8
        default 0

	choice G722_CODEC_RUN_CPU
		prompt "Select G722 Codec run cpu"
		default G722_CODEC_RUN_ON_CPU1

		config G722_CODEC_RUN_ON_CPU1
		bool "Select g722 codec run on cpu1"
		help
			Use g722 codec in avdk sdk

		config G722_CODEC_RUN_ON_CPU0
		bool "Select g722 codec run on cpu0"
		help
			Use g722 codec in agora_iot_sdk
	endchoice

endmenu
```

## projects/beken_wss/main/Kconfig.projbuild
```kconfig
menu "Beken_Genie Project Configuration"
    config LDO3V3_ENABLE
        bool "Enabel LDO_3V3"
        default n

    config LDO3V3_CTRL_GPIO
        depends on LDO3V3_ENABLE
        int "Set LDO_3V3 Control Gpio"
        range 0 100
        default 52

	config NETWORK_AUTO_RECONNECT
		bool "Enable auto reconnect Network"
		default y
endmenu
```

## projects/beken_wss_nopsram/main/Kconfig.projbuild
```kconfig
menu "Beken_Genie Project Configuration"
    config LDO3V3_ENABLE
        bool "Enabel LDO_3V3"
        default n

    config LDO3V3_CTRL_GPIO
        depends on LDO3V3_ENABLE
        int "Set LDO_3V3 Control Gpio"
        range 0 100
        default 52

    config NETWORK_AUTO_RECONNECT
        bool "Enable auto reconnect Network"
        default y

    config LCD_SPI_REFRESH_WITH_QSPI_MAPPING_MODE
        bool "Enabel LCD_SPI_REFRESH_WITH_QSPI_MAPPING_MODE"
        default y

    config LCD_SPI_BACKLIGHT_PIN
        int "Set LCD SPI backlight pin"
        default 43

    config LCD0_SPI_RESET_PIN
        int "Set LCD QSPI TE pin"
        default 40

    config LCD0_SPI_DC_PIN
        int "Set LCD QSPI TE pin"
        default 25

    config LCD1_SPI_RESET_PIN
        int "Set LCD QSPI TE pin"
        default 41

    config LCD1_SPI_DC_PIN
        int "Set LCD QSPI TE pin"
        default 5

    config IMAGE_MAX_WIDTH
        int "Set pipeline decode max image width"
        default 320
        
endmenu
```

## projects/common_components/audio_engine/Kconfig
```kconfig
menu "audio engine"
	config AUDIO_FRAME_DURATION_MS
		int "default audio frame duration in ms"
		range 20 60
		default 20

	config AUDIO_ADC_SAMP_RATE
		int "ADC sample rate"
		default 16000

	config AUDIO_DAC_SAMP_RATE
		int "DAC sample rate"
		default 16000

	config AUDIO_ENCODER_TYPE
		string "DAC sample rate"
		default "G722"

	config AUDIO_DECODER_TYPE
		string "DAC sample rate"
		default "G722"
endmenu
```

## projects/common_components/bk_app_event/Kconfig
```kconfig
menu "app_event"
	  config APP_EVT
        bool "Enable APP_EVT"
        default y

endmenu
```

## projects/common_components/bk_boarding_service/Kconfig
```kconfig
menu "Beken Common Components Boarding Service"
	config BK_BOARDING_SERVICE
		bool "Enable Beken Smart Config"
		depends on BK_SMART_CONFIG
		default y
endmenu
```

## projects/common_components/bk_countdown/Kconfig
```kconfig
menu "countdown"
	  config COUNTDOWN
        bool "Enable COUNTDOWN"
        default n
endmenu
```

## projects/common_components/bk_key_app/Kconfig
```kconfig
menu "key_app"
	  config USR_KEY_CFG_EN
        bool "Enable user-defined KEY config for each project"
        default n
endmenu
```

## projects/common_components/bk_led_blink/Kconfig
```kconfig
menu "led_blink"
	  config LED_BLINK
        bool "Enable LED_BLINK"
        default n
endmenu
```

## projects/common_components/bk_motor/Kconfig
```kconfig
menu "motor"
    config MOTOR
        depends on PWM
        bool "Enable MOTOR"
        default n
endmenu
```

## projects/common_components/bk_smart_config/Kconfig
```kconfig
menu "Beken Common Components Smart Config"
	config BK_SMART_CONFIG
		bool "Enable Beken Smart Config"
		depends on SYS_CPU0
		default y

	config NETWORK_AUTO_RECONNECT
		bool "Enable auto reconnect Network"
		depends on BK_SMART_CONFIG
		default y
		
	config ENABLE_AGORA_DATASTREAM
		bool "Enable Agora Data Stream"
		depends on AGORA_IOT_SDK
		default n
		
	config BK_DEV_STARTUP_AGENT
        bool "Enable start agent on device"
		default n
endmenu
```

## projects/common_components/dual_screen_avi_play/Kconfig
```kconfig
menu "Dual_screen_avi_play"
    config DUAL_SCREEN_AVI_PLAY
    bool "Enable DUAL_SCREEN_AVI_PLAY"
    default n
endmenu
```

## projects/common_components/network_transfer/Kconfig
```kconfig
menu "net_transfer"
	config BK_WSS_TRANS
		bool "Enable Beken Websocket Transmit for AI"
		default n

	config BK_WSS_TRANS_NOPSRAM
		bool "Enable Websocket Transmit for AI without PSRAM"
		default n

	config VOLC_ENABLE_VISION_BY_DEFAULT
		bool "Enable visual recognition for volc_rtc by default"
		default n

	config VOLC_ENABLE_SUBTITLE_BY_DEFAULT
		bool "Enable subtitle for volc_rtc by default"
		default n

	config SENSENOVA_ENABLE
		bool "Enable sensenova with aogra by default"
		default n
endmenu
```

## projects/common_components/single_screen_avi_play/Kconfig
```kconfig
menu "Single_screen_avi_play"
    config SINGLE_SCREEN_AVI_PLAY
    bool "Enable SINGLE_SCREEN_AVI_PLAY"
    default n
endmenu
```

## projects/common_components/single_screen_font_display/Kconfig
```kconfig
menu "Single_screen_font_display"
    config SINGLE_SCREEN_FONT_DISPLAY
    bool "Enable SINGLE_SCREEN_FONT_DISPLAY"
    default n
endmenu
```

## projects/common_components/video_engine/Kconfig
```kconfig
menu "video_engine"

	choice VIDEO_ENGINE_USE_CAMERA_TYPE
		prompt "Select video engine use camera type"
		default VIDEO_ENGINE_USE_DVP_CAMERA

		config VIDEO_ENGINE_USE_DVP_CAMERA
		bool "Select DVP camera"
		help
			Select DVP camera

		config VIDEO_ENGINE_USE_UVC_CAMERA
		bool "Select UVC camera"
		help
			Select UVC camera
	endchoice

	choice VIDEO_ENGINE_IMAGE_FORMAT
		prompt "Select video engine image format"
		default VIDEO_ENGINE_JPEG_FORMAT

		config VIDEO_ENGINE_JPEG_FORMAT
		bool "Select JPEG image format"
		help
			Select JPEG image format

		config VIDEO_ENGINE_H264_FORMAT
		bool "Select H264 image format"
		help
			Select H264 image format
	endchoice

	config VIDEO_ENGINE_RESOLUTION_WIDTH
	int "Default size of the width"
	range 1 2000
	default 1280
	help
		Set the size of the resolution width, The recommended value is 1280 .

	config VIDEO_ENGINE_RESOLUTION_HEIGHT
	int "Default size of the height"
	range 1 2000
	default 720
	help
		Set the size of the resolution height, The recommended value is 720 .

endmenu
```

## projects/soundhub/main/Kconfig.projbuild
```kconfig
menu "Beken_Genie Project Configuration"

    config A2DP_SINK_DEMO
        bool "a2dp sink demo"
        depends on BT
        default y

    config HFP_HF_DEMO
        bool "hfp hf demo"
        depends on BT
        default n

    config A2DP_SINK_DEMO_SET_SINK_CAP
        bool "a2dp set cap"
        depends on A2DP_SINK_DEMO
        default n

    config LDO3V3_ENABLE
        bool "Enabel LDO_3V3"
        default n

    config LDO3V3_CTRL_GPIO
        depends on LDO3V3_ENABLE
        int "Set LDO_3V3 Control Gpio"
        range 0 100
        default 52

    config HARDWARE_SPEAKER_VER
        int "select HARDWARE_SPEAKER_VER"
        range 0 8
        default 0

	choice G722_CODEC_RUN_CPU
		prompt "Select G722 Codec run cpu"
		default G722_CODEC_RUN_ON_CPU1

		config G722_CODEC_RUN_ON_CPU1
		bool "Select g722 codec run on cpu1"
		help
			Use g722 codec in avdk sdk

		config G722_CODEC_RUN_ON_CPU0
		bool "Select g722 codec run on cpu0"
		help
			Use g722 codec in agora_iot_sdk
	endchoice

endmenu
```

## projects/soundhub_wss/main/Kconfig.projbuild
```kconfig
menu "Beken_Genie Project Configuration"

    config A2DP_SINK_DEMO
        bool "a2dp sink demo"
        depends on BT
        default y

    config HFP_HF_DEMO
        bool "hfp hf demo"
        depends on BT
        default n

    config A2DP_SINK_DEMO_SET_SINK_CAP
        bool "a2dp set cap"
        depends on A2DP_SINK_DEMO
        default n

    config LDO3V3_ENABLE
        bool "Enabel LDO_3V3"
        default n

    config LDO3V3_CTRL_GPIO
        depends on LDO3V3_ENABLE
        int "Set LDO_3V3 Control Gpio"
        range 0 100
        default 52

    config LCD_BACKLIGHT_GPIO
        int "Set LCD Backlight Control Gpio"
        range 0 100
        default 25

    config LCD_QSPI_RESET_PIN
        int "Set LCD QSPI Reset Gpio"
        range 0 100
        default 45

    config LCD_QSPI_ID
        int "Set LCD QSPI ID"
        default 0
        help
            0 - QSPI_ID_0
            1 - QSPI_ID_1

	config NETWORK_AUTO_RECONNECT
		bool "Enable auto reconnect Network"
		default y
endmenu
```

## projects/volc_rtc/main/Kconfig.projbuild
```kconfig
menu "volc_rtc Project Configuration"
    config LDO3V3_ENABLE
        bool "Enabel LDO_3V3"
        default n

    config LDO3V3_CTRL_GPIO
        depends on LDO3V3_ENABLE
        int "Set LDO_3V3 Control Gpio"
        range 0 100
        default 52
				
    config HARDWARE_SPEAKER_VER
        int "select HARDWARE_SPEAKER_VER"
        range 0 8
        default 0
endmenu
```
